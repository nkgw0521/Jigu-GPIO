/************************************************************************/
/* MODULE:	   UARTライブラリ モジュール	   */
/************************************************************************/
/**
	@file		UART_Lib.c
	@brief		UARTライブラリ モジュール
	@author 	y.nakagawa
*/

/************************************************************************/
/* INCLUDE FILE SECTION													*/
/************************************************************************/
#include "system.h"
#include "uart_lib.h"


/************************************************************************/
/* MACRO DEFINITION SECTION												*/
/************************************************************************/
#define UART_PRINTF_BUFSIZE		(128)
#define UART_TX_ASSERT_SIZE		(128)

/************************************************************************/
/* TYPEDEF DEFINITION SECTION											*/
/************************************************************************/
/* nothing */

/************************************************************************/
/* GLOBAL DATA DEFINITION SECTION(PUBLIC)								*/
/************************************************************************/
/* nothing */

/************************************************************************/
/* GLOBAL DATA DEFINITION SECTION(static)								*/
/************************************************************************/
/* nothing */

/************************************************************************/
/* GLOBAL DATA DEFINITION SECTION(extern)								*/
/************************************************************************/
/* nothing */

/************************************************************************/
/* FUNCTION PROTOTYPE DEFINITION SECTION(PUBLIC)						*/
/************************************************************************/
/* nothing */

/************************************************************************/
/* FUNCTION PROTOTYPE DEFINITION SECTION(static)						*/
/************************************************************************/
/* nothing */


/************************************************************************/
/* FUNCTION PROTOTYPE DEFINITION SECTION(extern)						*/
/************************************************************************/
/* nothing */


/********************************************************************************/
/**
	@brief	UART_Getc 関数

	Non-Blocking

	@author	y.nakagawa
	@date	2016/10/13(木) 10:09:44

	@return	char	受信データが無い場合は0を応答。
*/
/********************************************************************************/
PUBLIC
char
UART_Getc(void)
{
	int c;

	for (;;)
	{
		/* UART受信処理 */
		if ((c = UART_Read()) >= 0)
		{
			return (char)c;
		}
	}
}


/********************************************************************************/
/**
	@brief	UART_Put 関数

	@author	y.nakagawa
	@date	2018/10/12(金) 10:18:56

	@param[out]	buf		(char *)	バッファ
	@param[in]	len		(int)		長さ

	@return	なし (none)
*/
/********************************************************************************/
PUBLIC
void
UART_Put( char * buf, int len )
{
	if ( (0 < len) && (buf != NULL) )
	{
		UART_Write( (uint8_t *)buf, len );
	}
}


/********************************************************************************/
/**
	@brief	UART_Puts 関数

	@author	y.nakagawa
	@date	2017/11/01(水) 12:07:26

	@param[out]	buf		(char*)	バッファ

	@return	なし (none)
*/
/********************************************************************************/
PUBLIC
void
UART_Puts( char* buf )
{
	int	len = 0 ;

	if ( buf != NULL )
	{
		len = strlen( buf ) ;
		UART_Write( (uint8_t *)buf, len );
	}
}

/********************************************************************************/
/**
	@brief	UART_Putc 関数

	@author	y.nakagawa
	@date	2017/11/01(水) 12:07:31

	@param[in]	ch		(char)	※ 要コメント

	@return	なし (none)
*/
/********************************************************************************/
PUBLIC
void
UART_Putc( char ch )
{
	UART_Write( (uint8_t *)&ch, 1 );
}


/********************************************************************************/
/**
	@brief	UART1にアサーションメッセージを表示する
	@author y.nakagawa
	@date	2017/04/06

	@param[in]	func	関数名
	@param[in]	line	行番号
	@retval		なし

	@note	致命的な問題を検出した時に用いる。UART1専用。
			少しでも出力できる可能性を上げるために、この関数内で直接レジスタに
			送信データを書き込んでいる。
*/
/********************************************************************************/
PUBLIC
void
UART_AssertionFailed(const char *func, int line)
{
	__disable_irq() ;	/* 割り込み禁止 */

	char buf[UART_TX_ASSERT_SIZE];	/* このサイズで変換後文字列の上限が決まる */
	snprintf(buf, sizeof (buf), UART_CRLF "[Assertion failed] %s:%d" UART_CRLF, func, line);
	UART_EmergencyPrint( buf ) ;
	HALT();
}
